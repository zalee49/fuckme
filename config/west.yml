## config/west.yml
```yaml
manifest:
  remotes:
    - name: zmkfirmware
      url-base: https://github.com/zmkfirmware
  projects:
    - name: zmk
      remote: zmkfirmware
      revision: main
      import: app/west.yml
    - name: zmk-aurora-lily58
      url: https://github.com/splitkb/zmk-aurora-lily58
      revision: main
  self:
    path: config
# Force Cache Reset 1
```
